## LSM/mkdir_secure/Kconfig
```kconfig
config SECURITY_MKDIRSAFE
    bool "Safe mkdir module"
    default n
    help
        This module just log all mkdir calls.
        If you are unsure how to answer this question, answer N. 
```

## LSM/secure_edit/Kconfig
```kconfig
config SECURITY_SECUREEDIT
    bool "Safe files editing module"
    default n
    help
        This module just disable edit functions for specified files.
        If you are unsure how to answer this question, answer N. 
```
